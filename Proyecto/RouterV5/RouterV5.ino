#include <WiFi.h>
#include <WebServer.h>
#include <Wire.h>
#include <Adafruit_GFX.h>
#include <Adafruit_SSD1306.h>
#include <esp_task_wdt.h>
#include <Update.h>
#include "lwip/lwip_napt.h" 

#define ANCHO 128
#define ALTO 64
#define LED_SISTEMA 2 
#define TIEMPO_WDT 15 

// --- LA SEGURIDAD: LA RUTA SECRETA ---
#define RUTA_SECRETA "/panel_escom_77" 

// --- CREDENCIALES ADMINISTRADOR ---
const char* http_user = "Angel_Admin";
const char* http_pass = "Proto_ESCOM_0x44"; 

Adafruit_SSD1306 disp1(ANCHO, ALTO, &Wire, -1);
WebServer servidor(80);

// --- VARIABLES DE CONTROL ---
int modoEnergia = 1; 
unsigned long tUltimaPantalla = 0;
String registroLog = "[SISTEMA] GAMA NEXUS V5 ACTIVO";
int potenciaWifi = 19; 
bool internetActivo = false;
int modoPantalla = 0; // 0 = Mostrar Info de Red (Carrusel), 1 = Mostrar Logo Fijo

// --- SALVAPANTALLAS (LOGOTIPO GAMA 128x64) ---
const unsigned char epd_bitmap_final_image__3_ [] PROGMEM = {
  0xff, 0xff, 0xff, 0xff, 0x00, 0x00, 0x00, 0x00, 0x00, 0x00, 0x00, 0x00, 0xff, 0xff, 0xff, 0xff, 
  0xff, 0xff, 0xff, 0xff, 0x00, 0x00, 0x00, 0x00, 0x00, 0x00, 0x00, 0x00, 0xff, 0xff, 0xff, 0xff, 
  0xff, 0xff, 0xff, 0xff, 0x00, 0x00, 0x00, 0x00, 0x00, 0x00, 0x00, 0x00, 0xff, 0xff, 0xff, 0xff, 
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  0xff, 0xff, 0xff, 0xff, 0x00, 0x00, 0x00, 0x00, 0x00, 0x00, 0x00, 0x00, 0xff, 0xff, 0xff, 0xff
};

// --- INTERFAZ WEB COMPARTIDA (CSS) ---
const char css_estilos[] PROGMEM = R"rawliteral(
<style>
@import url('https://fonts.googleapis.com/css2?family=Orbitron:wght@400;700&display=swap');
body{background:#0a0a0f;color:#00ffcc;font-family:'Orbitron',sans-serif;padding:15px;text-align:center;margin:0;}
.tarjeta{background:rgba(10,15,25,0.9);padding:25px;border-radius:15px;border:1px solid #00ffcc;box-shadow:0 0 20px rgba(0,255,204,0.2);max-width:450px;margin:auto;}
.borde-admin{border-color:#ff0055; box-shadow:0 0 20px rgba(255,0,85,0.4);}
h1{font-size:1.5rem;text-shadow:0 0 10px #00ffcc;margin-bottom:5px;}
.estado{font-size:1.2rem;font-weight:bold;margin-bottom:15px;}
.consola{background:#000;color:#0f0;padding:10px;height:100px;overflow-y:auto;font-family:monospace;font-size:0.8em;text-align:left;margin:15px 0;border:1px solid #333;}
.btn{display:inline-block;padding:12px;margin:5px 1%;text-decoration:none;border-radius:5px;font-weight:bold;color:#000;border:none;cursor:pointer;width:45%;font-family:'Orbitron',sans-serif;}
.btn-full{width:95%; background:#ff0055; color:#fff;}
.btn-verde{width:95%; background:#00ffcc; color:#000; margin-top:10px;}
.slider-container{margin:20px 0;padding:15px;background:rgba(0,255,204,0.05);border-radius:10px;border:1px dashed #00ffcc;}
input[type=range]{width:100%;margin-top:10px;accent-color:#00ffcc;}
input[type=text], input[type=password]{width:90%;padding:10px;margin:5px;border-radius:5px;background:#050a14;color:white;border:1px solid #00ffcc;font-family:'Orbitron',sans-serif;}
input[type=file]{background:#fff; color:#000; padding:10px; width:90%; border-radius:5px;}
</style>
)rawliteral";

// --- HTML VISOR PUBLICO ---
const char html_publico[] PROGMEM = R"rawliteral(
<!DOCTYPE html><html><head><meta charset='UTF-8'><meta name='viewport' content='width=device-width, initial-scale=1'>
%CSS%
</head><body><div class='tarjeta'>
<h1>GAMA NEXUS</h1><p style='color:#fff'>[ VISOR PUBLICO ]</p>
<div class='estado'>ESTADO NAT: %ESTADO_INTERNET%</div>
<div class='consola'><code>%LOG%</code></div>
<div class='slider-container'>
  <p>ESTADO DEL NUCLEO: <b style='color:#0f0'>SELLADO (V5)</b></p>
</div>
<p style='font-size:0.7em; color:#666;'>ACCESO DENEGADO PARA USUARIOS ESTANDAR</p>
</div></body></html>
)rawliteral";

// --- HTML PANEL ADMIN ---
const char html_admin[] PROGMEM = R"rawliteral(
<!DOCTYPE html><html><head><meta charset='UTF-8'><meta name='viewport' content='width=device-width, initial-scale=1'>
%CSS%
<script>function actualizar(v){document.getElementById('valP').innerText=v+' dBm';}</script>
</head><body><div class='tarjeta borde-admin'>
<h1 style='text-shadow: 0 0 10px #ff0055;'>GAMA NEXUS</h1><p style='color:#ff0055'>[ TERMINAL ADMINISTRADOR ]</p>
<div class='consola'><code>%LOG%</code></div>

<div class='slider-container' style='border-color:#cc00ff'>
  <h3 style='color:#cc00ff'>CONTROL PANTALLA OLED</h3>
  <a href='/pantalla?m=0'><button class='btn' style='background:#cc00ff; color:#fff;'>VER DATOS</button></a>
  <a href='/pantalla?m=1'><button class='btn' style='background:#fff'>VER LOGO</button></a>
</div>

<div class='slider-container' style='border-color:#0f0'>
  <h3 style='color:#0f0'>ENRUTAMIENTO NAT (REPETIDOR)</h3>
  <form action='/conectar_nat' method='POST'>
    <input type='text' name='s' placeholder='RED A REPETIR (SSID)' required>
    <input type='password' name='p' placeholder='CONTRASEÑA' required>
    <input type='submit' class='btn btn-verde' value='ANCLAR Y COMPARTIR INTERNET'>
  </form>
</div>

<a href='/pwr?m=0'><button class='btn' style='background:#00d4ff'>SIGILO</button></a>
<a href='/pwr?m=1'><button class='btn' style='background:#ff3300'>MAXIMO</button></a>

<div class='slider-container'>
  <h3>TX WIFI: <span id='valP'>%POTENCIA% dBm</span></h3>
  <form action='/set_potencia' method='GET'>
    <input type='range' name='v' min='2' max='20' value='%POTENCIA%' oninput='actualizar(this.value)' onchange='this.form.submit()'>
  </form>
</div>

<div class='slider-container' style='border-color:#ff0055'>
  <h3 style='color:#ff0055'>SISTEMA OTA</h3>
  <form method='POST' action='/update' enctype='multipart/form-data'>
    <input type='file' name='update' accept='.bin' required><br><br>
    <input type='submit' class='btn btn-full' value='INSTALAR FIRMWARE'>
  </form>
</div>
<a href='/' style='color:#00ffcc'>Cerrar Terminal y Sellar</a>
</div></body></html>
)rawliteral";

void registrar(String m) { 
  registroLog = "[" + String(millis()/1000) + "s] " + m + "<br>" + registroLog; 
  if(registroLog.length() > 600) registroLog = registroLog.substring(0, 500);
}

// ================= MOTOR DE SEGURIDAD LÓGICO =================
bool accesoAutorizado() {
  if (!servidor.authenticate(http_user, http_pass)) { 
    servidor.requestAuthentication(); 
    return false; 
  }
  return true;
}

// ================= RUTAS WEB =================
void handleRoot() {
  String html = String(html_publico);
  html.replace("%CSS%", String(css_estilos));
  html.replace("%ESTADO_INTERNET%", internetActivo ? "<span style='color:#0f0'>ENRUTANDO INTERNET</span>" : "<span style='color:#ff3300'>SOLO INTRANET LOCAL</span>");
  html.replace("%LOG%", registroLog);
  servidor.send(200, "text/html", html);
}

void handleAdmin() {
  if (!accesoAutorizado()) return; 
  String html = String(html_admin);
  html.replace("%CSS%", String(css_estilos));
  html.replace("%LOG%", registroLog);
  html.replace("%POTENCIA%", String(potenciaWifi));
  servidor.send(200, "text/html", html);
}

void handlePantalla() {
  if (!accesoAutorizado()) return; 
  modoPantalla = servidor.arg("m").toInt();
  registrar(modoPantalla == 0 ? "OLED: Modo Info Activo" : "OLED: Modo Logo Activo");
  servidor.sendHeader("Location", RUTA_SECRETA);
  servidor.send(303);
}

void handlePwr() {
  if (!accesoAutorizado()) return; 
  modoEnergia = servidor.arg("m").toInt();
  if(modoEnergia == 0) { 
    setCpuFrequencyMhz(80); Wire.begin(21, 22); registrar("PWR: Sigilo (80MHz)"); 
  } else { 
    setCpuFrequencyMhz(240); Wire.begin(21, 22); registrar("PWR: Maximo (240MHz)"); 
  }
  servidor.sendHeader("Location", RUTA_SECRETA);
  servidor.send(303);
}

void handlePotencia() {
  if (!accesoAutorizado()) return; 
  if (servidor.hasArg("v")) {
    potenciaWifi = servidor.arg("v").toInt();
    wifi_power_t setPwr = WIFI_POWER_19_5dBm;
    if (potenciaWifi <= 5) setPwr = WIFI_POWER_5dBm;
    else if (potenciaWifi <= 8) setPwr = WIFI_POWER_8_5dBm;
    else if (potenciaWifi <= 15) setPwr = WIFI_POWER_15dBm;
    WiFi.setTxPower(setPwr);
    registrar("NEXUS: TX a " + String(potenciaWifi) + " dBm");
  }
  servidor.sendHeader("Location", RUTA_SECRETA);
  servidor.send(303);
}

void handleConectarNAT() {
  if (!accesoAutorizado()) return;
  String ssid = servidor.arg("s");
  String pass = servidor.arg("p");
  
  // Mensaje previo para que el celular sepa que se va a desconectar por el salto de canal
  String html = "<html><body style='background:#000;color:#0f0;font-family:monospace;text-align:center;padding:50px;'>";
  html += "<h2>INICIANDO SALTO DE CANAL NAT</h2>";
  html += "<p>El modem se esta anclando a: <b>" + ssid + "</b></p>";
  html += "<p>Tu celular se desconectara del WiFi GAMA_Nexus unos segundos.</p>";
  html += "<p>Revisa la pantalla OLED. Si dice ONLINE, reconecta tu WiFi y recarga la pagina secreta.</p>";
  html += "<br><a href='" + String(RUTA_SECRETA) + "' style='color:#00ffcc;'>Volver al Panel</a>";
  html += "</body></html>";
  servidor.send(200, "text/html", html);
  
  delay(1000); 
  
  registrar("NAT: Anclando a " + ssid + "...");
  WiFi.begin(ssid.c_str(), pass.c_str());
  
  int intentos = 0;
  while(WiFi.status() != WL_CONNECTED && intentos < 15) {
    delay(500);
    intentos++;
  }
  
  if(WiFi.status() == WL_CONNECTED) {
    ip_napt_enable((uint32_t)WiFi.softAPIP(), 1);
    internetActivo = true;
    registrar("NAT: CONECTADO Y ENRUTANDO INTERNET");
  } else {
    internetActivo = false;
    registrar("NAT ERROR: Fallo al conectar. Verifique credenciales.");
  }
}

// ================= SETUP =================
void setup() {
  esp_task_wdt_config_t wdt_config = { .timeout_ms = TIEMPO_WDT * 1000, .idle_core_mask = (1 << portNUM_PROCESSORS) - 1, .trigger_panic = true };
  esp_task_wdt_init(&wdt_config); esp_task_wdt_add(NULL); 

  pinMode(LED_SISTEMA, OUTPUT);

  Wire.begin(21, 22); 
  disp1.begin(SSD1306_SWITCHCAPVCC, 0x3C);

  // MODO DUAL: Se conecta a una red (STA) y crea la suya propia (AP)
  WiFi.mode(WIFI_AP_STA);
  WiFi.setTxPower(WIFI_POWER_19_5dBm); 
  
  // Nombre de red y contraseña
  WiFi.softAP("GAMA_Nexus", "GAMA_2026_SEC", 1, 0, 4);

  // --- REGISTRO DE RUTAS WEB ---
  servidor.on("/", handleRoot);
  servidor.on(RUTA_SECRETA, handleAdmin); 
  servidor.on("/pantalla", handlePantalla); 
  servidor.on("/pwr", handlePwr);
  servidor.on("/set_potencia", handlePotencia);
  servidor.on("/conectar_nat", HTTP_POST, handleConectarNAT);
  
  // Falso error 404 para ocultar el sistema a intrusos
  servidor.onNotFound([]() {
    servidor.send(404, "text/plain", "ERROR 404: DIRECTORIO INEXISTENTE EN EL NUCLEO GAMA.");
  });

  // OTA (Actualización sin cables)
  servidor.on("/update", HTTP_POST, []() {
    if (!accesoAutorizado()) return;
    servidor.sendHeader("Connection", "close");
    servidor.send(200, "text/plain", (Update.hasError()) ? "FALLO DE ACTUALIZACION" : "EXITO! REINICIANDO SISTEMA...");
    delay(1000);
    ESP.restart();
  }, []() {
    if (!servidor.authenticate(http_user, http_pass)) return; 
    HTTPUpload& upload = servidor.upload();
    if (upload.status == UPLOAD_FILE_START) {
      if (!Update.begin(UPDATE_SIZE_UNKNOWN)) Update.printError(Serial);
    } else if (upload.status == UPLOAD_FILE_WRITE) {
      if (Update.write(upload.buf, upload.currentSize) != upload.currentSize) Update.printError(Serial);
    } else if (upload.status == UPLOAD_FILE_END) {
      if (Update.end(true)) registrar("OTA: Sistema Actualizado");
    }
  });

  servidor.begin();
}

void loop() {
  esp_task_wdt_reset();
  servidor.handleClient();        
  unsigned long t = millis();

  // Optimización OLED (Actualiza pantalla cada 250ms)
  if (t - tUltimaPantalla > 250) {
    tUltimaPantalla = t;
    disp1.clearDisplay();
    disp1.setTextColor(WHITE);
    
    // --- LÓGICA MANUAL DE PANTALLA ---
    if (modoPantalla == 0) {
      
      // MODO DATOS DE RED: Carrusel automático (Cambia cada 4 segundos)
      int carrusel = (t / 4000) % 3; 

      if (carrusel == 0) {
        // VISTA 1: Información Básica
        disp1.setCursor(0,0); disp1.print("GAMA NEXUS V5");
        disp1.drawFastHLine(0, 10, 128, WHITE);
        
        disp1.setCursor(0, 20); disp1.print("IP: "); disp1.print(WiFi.softAPIP());
        disp1.setCursor(0, 35); disp1.print("RED: GAMA_Nexus");
        disp1.setCursor(0, 50); disp1.print("TX PWR: "); disp1.print(potenciaWifi); disp1.print(" dBm");
      }
      else if (carrusel == 1) {
        // VISTA 2: Nodos Conectados (En grande)
        disp1.setCursor(0,0); disp1.print("GAMA NEXUS V5");
        disp1.drawFastHLine(0, 10, 128, WHITE);
        
        disp1.setCursor(0, 25); disp1.print("DISPOSITIVOS (NODOS):");
        disp1.setTextSize(2);
        disp1.setCursor(55, 40); disp1.print(WiFi.softAPgetStationNum());
        disp1.setTextSize(1); // Regresamos el tamaño a normal
      }
      else if (carrusel == 2) {
        // VISTA 3: Estado del Repetidor (NAT)
        disp1.setCursor(0,0); disp1.print("GAMA NEXUS V5");
        disp1.drawFastHLine(0, 10, 128, WHITE);
        
        disp1.setCursor(0, 20); disp1.print("MODO REPETIDOR:");
        if (internetActivo) {
          disp1.setCursor(0, 35); disp1.print("ESTADO: ONLINE");
          disp1.setCursor(0, 50); disp1.print("ENRUTANDO INTERNET");
        } else {
          disp1.setCursor(0, 35); disp1.print("ESTADO: OFFLINE");
          disp1.setCursor(0, 50); disp1.print("SOLO INTRANET");
        }
      }

    } else {
      
      // MODO LOGO FIJO (Salvapantallas manual)
      disp1.drawBitmap(0, 0, epd_bitmap_final_image__3_, 128, 64, WHITE);
      
    }
    
    disp1.display();
  }

  // Parpadeo del LED de estado
  if(modoEnergia == 1) digitalWrite(LED_SISTEMA, (t / 500) % 2);
  else digitalWrite(LED_SISTEMA, LOW);
}